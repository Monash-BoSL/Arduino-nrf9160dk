## CMakeLists.txt
```
# SPDX-License-Identifier: Apache-2.0

cmake_minimum_required(VERSION 3.20.0)

cmake_path(SET ZephyrBase $ENV{ZEPHYR_BASE})


set(DTC_OVERLAY_FILE ${ZephyrBase}/../modules/lib/Arduino-Zephyr-API/variants/${BOARD}/${BOARD}.overlay)
set(ZEPHYR_EXTRA_MODULES ${ZephyrBase}/../modules/lib/Arduino-Zephyr-API)

find_package(Zephyr REQUIRED HINTS ${ZephyrBase})

project(Everything)

target_sources(app PRIVATE src/main.cpp)
target_sources(app PRIVATE src/digital.cpp)
target_sources(app PRIVATE src/analog.cpp)
target_sources(app PRIVATE src/rtt.cpp)
target_sources(app PRIVATE src/serial.cpp)

# SEGGER_RTT_printf.c is a copy of /c/ncs/v2.5.0/modules/debug/segger/SEGGER/SEGGER_RTT_printf.c
# Copying it into the project allows us to ignore CONFIG_RTT_CONSOLE Kconfig directive which
# directs all output to RTT. This way SEGGER_RTT_printf() output goes to RTT while printf() 
# goes to serial console. Serial.print() output incidentally goes to both RTT and the serial 
# console.
target_sources(app PRIVATE src/SEGGER_RTT_printf.c)
```

## prj.conf
```kconfig
CONFIG_ADC=y
CONFIG_GPIO=y                                 # default y
CONFIG_ARDUINO_API=y

CONFIG_TRUSTED_EXECUTION_NONSECURE=y

CONFIG_PRINTK=y
CONFIG_CONSOLE=y
CONFIG_USE_SEGGER_RTT=y

CONFIG_SERIAL=y
CONFIG_UART_INTERRUPT_DRIVEN=y

# UART logging devzone.nordicsemi.com/.../nrf91-zephyr-enable-lte-logging
CONFIG_LOG=y
# CONFIG_LOG_MODE_IMMEDIATE=y
CONFIG_STDOUT_CONSOLE=y
CONFIG_UART_CONSOLE=y

CONFIG_PM=y

## I2C
CONFIG_I2C=y
CONFIG_I2C_NRFX=y

## FILE SYSTEM SD CARD
CONFIG_DISK_DRIVER_SDMMC=y
CONFIG_FILE_SYSTEM=y
CONFIG_FAT_FILESYSTEM_ELM=y
CONFIG_FS_FATFS_LFN=y

CONFIG_DISK_ACCESS=y
CONFIG_DISK_DRIVERS=y
CONFIG_SPI=y
CONFIG_SPI_NRFX_RAM_BUFFER_SIZE=8

## memory
CONFIG_MAIN_STACK_SIZE=4096
CONFIG_HEAP_MEM_POOL_SIZE=16384
CONFIG_SYSTEM_WORKQUEUE_STACK_SIZE=4096

## LTE MODEM
CONFIG_NRF_MODEM_LIB=y
CONFIG_AT_MONITOR=y
CONFIG_AT_HOST_LIBRARY=y

## LTE link control
CONFIG_LTE_LINK_CONTROL=y
CONFIG_LTE_AUTO_INIT_AND_CONNECT=n
# LTE parameters
## Network Mode / LTE category
CONFIG_LTE_NETWORK_MODE_LTE_M=y

## PSM
# CONFIG_UDP_PSM_ENABLE=y
# CONFIG_PDN_LEGACY_PCO=y
CONFIG_LTE_PSM_REQ_RPTAU="00000110"
CONFIG_LTE_PSM_REQ_RAT="00000101"

## eDRX
# CONFIG_UDP_EDRX_ENABLE=n
CONFIG_LTE_EDRX_REQ_VALUE_LTE_M="1001"

## RAI
# CONFIG_UDP_RAI_ENABLE=n
CONFIG_LTE_RAI_REQ_VALUE="4"


CONFIG_NETWORKING=y
CONFIG_NET_NATIVE=n
CONFIG_NET_SOCKETS=y
CONFIG_NET_SOCKETS_OFFLOAD=y
CONFIG_NET_SOCKETS_POSIX_NAMES=y

CONFIG_FTP_CLIENT=y
CONFIG_FTP_CLIENT_KEEPALIVE_TIME=60
CONFIG_FTP_CLIENT_LISTEN_TIME=10
CONFIG_FTP_CLIENT_LOG_LEVEL_INF=y

# CONFIG_NEWLIB_LIBC=y                   # when enabled, all printf lines do a double \n
CONFIG_NEWLIB_LIBC_FLOAT_PRINTF=y

## RTC
CONFIG_DATE_TIME=y
CONFIG_DATE_TIME_MODEM=y
CONFIG_DATE_TIME_NTP=n

## SLEEPY
# CONFIG_LTE_LINK_CONTROL=y
# CONFIG_LTE_PSM_REQ_RPTAU="10101010"
# CONFIG_LTE_PSM_REQ_RAT="00100001"

# Network
# CONFIG_NETWORKING=y
# CONFIG_NET_SOCKETS=y


#CONFIG_NO_OPTIMIZATIONS=y
CONFIG_DEBUG_OPTIMIZATIONS=y
#CONFIG_SPEED_OPTIMIZATIONS=y

CONFIG_WATCHDOG=y
CONFIG_WDT_DISABLE_AT_BOOT=n
```

## src/main.cpp
```c
#include <zephyr/kernel.h>
#include "analog.h"
#include "digital.h"
#include "rtt.h"
#include "serial.h"


////////////////////////////////////////
#define SLEEP_TIME_MS		(1000)

////////////////////////////////////////////////////////////////////////////////
// To strictly comply with UART timing, enable external XTAL oscillator
void enable_xtal(void)
{
	struct onoff_manager* clk_mgr = z_nrf_clock_control_get_onoff(CLOCK_CONTROL_NRF_SUBSYS_HF);

	static struct onoff_client cli = {};
	sys_notify_init_spinwait(&cli.notify);
	(void)onoff_request(clk_mgr, &cli);
}

////////////////////////////////////////////////////////////////////////////////
void setup_modem (void)
{
	int result = nrf_modem_lib_init();
	if (result != 0) 
	{
		printk("Modem library initialization failed, error: %d\n", result);
		k_oops();
	}
	printk("The AT host started\n");

	// From this point on, any command received on the VCOM0 will be transferred 
	// to VCOM1 which is connected to the modem. Too test, type any of the 
	// supported AT commands. E.g. AT, AT%XOPERID, AT%XMONITOR, AT%XTEMP?, etc.
}

////////////////////////////////////////////////////////////////////////////////
void setup (void)
{
	enable_xtal();
	setup_rtt();
	analog_setup();
	setup_digital();
	setup_serial();
	setup_modem();

	serial_out("Setup complete. Type AT command to send to the modem...");
}

////////////////////////////////////////////////////////////////////////////////
void loop (void)
{
	k_msleep(SLEEP_TIME_MS);

	analog_read();
	blink();
	rtt_print("Another sunny day\n");
	serial_read();			// This will not result in any action unless zephyr_setup_serial() had been executed. 
}

////////////////////////////////////////////////////////////////////////////////
#ifndef CONFIG_ARDUINO_API
int main (void)
{
	setup();

	while( true)
	{
		loop();
	}
	return 0;
}
#endif
```

## src/analog.cpp
```c
#include <zephyr/drivers/adc.h>
#include <zephyr/kernel.h>
#include <SEGGER_RTT.h>
#ifdef CONFIG_ARDUINO_API
	#include <Arduino.h>
#else
	#define pin_size_t	uint8_t
#endif

#define ANALOG_RESOLUTION_BITS  12
#define MAX_ADC_MV              (5000.0)
#define MAX_ADC_COUNT           ((1<<ANALOG_RESOLUTION_BITS) - 1)
#define ADC_MV_PER_COUNT        (MAX_ADC_MV / MAX_ADC_COUNT)
#define MV_IN_V					(1000)
#define ADC_COUNT_TO_MV(c)      (c * ADC_MV_PER_COUNT)
#define ADC_COUNT_TO_V(c)       (1.0 * c * ADC_MV_PER_COUNT / MV_IN_V)

// ADC node from the devicetree
#define ADC_NODE DT_ALIAS(adc0)

// Data of ADC device specified in devicetree
static const struct device* adc = DEVICE_DT_GET(ADC_NODE);

// Data array of ADC channels for the specified ADC.
static const struct adc_channel_cfg channel_cfgs[] = {
	DT_FOREACH_CHILD_SEP(ADC_NODE, ADC_CHANNEL_CFG_DT, (,))
};
//#define CHANNEL_COUNT			ARRAY_SIZE(channel_cfgs)
#define CHANNEL_COUNT			3

////////////////////////////////////////
uint16_t readings[CHANNEL_COUNT];
static struct adc_sequence sequence = {
	.options = NULL,
	.channels = 0,									// no sampling for now
	.buffer = readings,
	.buffer_size = sizeof(readings),				// buffer size in bytes, not number of samples
	.resolution = ANALOG_RESOLUTION_BITS,
	.calibrate = false
};

////////////////////////////////////////////////////////////////////////////////
void analog_setup (void)
{
	if (device_is_ready(adc) == false) {
		printf("ADC controller device %s not ready\n", adc->name);
		k_oops();
	}
}

////////////////////////////////////////////////////////////////////////////////
void adc_setup_sequence (void)
{
	// Configure channels individually prior to sampling
	for (size_t ch = 0U; ch < CHANNEL_COUNT; ch++) 
	{
		sequence.channels |= BIT(channel_cfgs[ch].channel_id);
		int err = adc_channel_setup(adc, &channel_cfgs[ch]);
		if (err < 0) {
			printf("Could not setup ADC channel #%d (%d)\n", ch, err);
			k_oops();
		}
	}
}

////////////////////////////////////////////////////////////////////////////////
void adc_read_sequence (void)
{
	int err = adc_read(adc, &sequence);
	if (err < 0) 
	{
		printf("Could not read ADC (err=%d)\n", err);
	}
	else
	{
		SEGGER_RTT_printf(0, "%s\n", adc->name);
		for (size_t ch = 0U; ch < CHANNEL_COUNT; ch++) 
		{
			uint32_t val = readings[ch];
			uint32_t val_mv = ADC_COUNT_TO_MV(val);

			SEGGER_RTT_printf(0, "  ch%d: 0x%04x (%4d) = %dmV\n", ch, val, val, val_mv);
		}
	}
}

////////////////////////////////////////////////////////////////////////////////
void adc_read_single (uint8_t ch)
{
	// Setup sequence to only sample the channel requested
	sequence.channels = BIT(channel_cfgs[ch].channel_id);

	// Setiup adc channel
	int err = adc_channel_setup(adc, &channel_cfgs[ch]);
	if (err < 0) {
		printf("Could not setup ADC channel #%d (%d)\n", ch, err);
		k_oops();
	}

	// Read
	err = adc_read(adc, &sequence);
	if (err < 0) 
	{
		printf("Could not read ADC (err=%d)\n", err);
	}
	else
	{
		uint32_t val = readings[0];
		uint32_t val_mv = ADC_COUNT_TO_MV(val);

		SEGGER_RTT_printf(0, "  ch%d: 0x%04x (%4d) = %dmV\n", ch, val, val, val_mv);
	}
}

////////////////////////////////////////////////////////////////////////////////
void adc_read_arduino (pin_size_t adc_pin)
{
#ifdef CONFIG_ARDUINO_API
	analogReadResolution(ANALOG_RESOLUTION_BITS);

	int val = analogRead(adc_pin);
	int val_mv = ADC_COUNT_TO_MV(val);
	SEGGER_RTT_printf(0, "  ch%d: 0x%04x (%4d) = %dmV\n", adc_pin, val, val, val_mv);
#else
	(void)adc_pin;
#endif
}

////////////////////////////////////////////////////////////////////////////////
void analog_read (void)
{
	SEGGER_RTT_printf(0, "adc_read_sequence\n");
	adc_setup_sequence();
	adc_read_sequence();

	SEGGER_RTT_printf(0, "adc_read_single\n");
	adc_read_single(0);
	adc_read_single(1);
	adc_read_single(2);

#ifdef CONFIG_ARDUINO_API
	SEGGER_RTT_printf(0, "adc_read_arduino\n");
	adc_read_arduino(A0);
	adc_read_arduino(A1);
	adc_read_arduino(A2);
#endif
}
```

## src/analog.h
```c
#ifdef CONFIG_ARDUINO_API
	#include <Arduino.h>
#endif

#ifndef INCLUDE_ANALOG_H

////////////////////////////////////////
void analog_setup (void);
void analog_read  (void);

#endif      // INCLUDE_ANALOG_H
```

## src/digital.cpp
```c
#include <zephyr/kernel.h>
#include <zephyr/drivers/gpio.h>
#ifdef CONFIG_ARDUINO_API
	#include <Arduino.h>
#endif

////////////////////////////////////////
#define DIM(x)				(sizeof(x)/sizeof(x[0]))

#define LED0_NODE DT_ALIAS(led0)
#define LED1_NODE DT_ALIAS(led1)
#define LED2_NODE DT_ALIAS(led2)
#define LED3_NODE DT_ALIAS(led3)

////////////////////////////////////////
//static const struct gpio_dt_spec led = GPIO_DT_SPEC_GET(LED0_NODE, gpios);
static const struct gpio_dt_spec zephyr_leds[] = 
{
	GPIO_DT_SPEC_GET(LED0_NODE, gpios),
	GPIO_DT_SPEC_GET(LED1_NODE, gpios),
	GPIO_DT_SPEC_GET(LED2_NODE, gpios),
	GPIO_DT_SPEC_GET(LED3_NODE, gpios)
};
#ifdef CONFIG_ARDUINO_API
	static const pin_size_t arduino_leds[] = { D2, D3, D4, D5 };
#endif

////////////////////////////////////////////////////////////////////////////////
static void setup_digital_arduino (void)
{
#ifdef CONFIG_ARDUINO_API
	for (uint8_t i=0; i<DIM(arduino_leds); ++i)
	{
		pinMode(arduino_leds[i], OUTPUT);
	}
#endif
}

////////////////////////////////////////////////////////////////////////////////
static void setup_digital_zephyr (void)
{
	for (uint8_t i=0; i<DIM(zephyr_leds); ++i)
	{
		if (gpio_is_ready_dt(&zephyr_leds[i]) == false)
		{
			k_oops();
		}
		int result = gpio_pin_configure_dt(&zephyr_leds[i], GPIO_OUTPUT_INACTIVE);
		if ( result  < 0)
		{
			k_oops();
		}
	}
}

////////////////////////////////////////////////////////////////////////////////
static void blink_zephyr (void)
{
	static bool		  led_state = false;
	static uint8_t	  index = 0;

	int result = gpio_pin_toggle_dt(&zephyr_leds[index]);
	if ( result  < 0)
	{
		k_oops();
	}

	if (led_state == false)
	{
		index++;
		if (index >= DIM(zephyr_leds))
		{
			index = 0;
		}
	}
}

////////////////////////////////////////////////////////////////////////////////
void setup_digital (void)
{
	setup_digital_arduino();
	setup_digital_zephyr();
}

////////////////////////////////////////////////////////////////////////////////
static void blink_arduino (void)
{
#ifdef CONFIG_ARDUINO_API
	static bool		  led_state = false;
	static uint8_t	  index = 0;

	led_state = !led_state;

	digitalWrite(arduino_leds[index], led_state ? HIGH : LOW);

	if (led_state == false)
	{
		index++;
		if (index >= DIM(arduino_leds))
		{
			index = 0;
		}
	}
#endif
}

////////////////////////////////////////////////////////////////////////////////
void blink (void)
{
	static uint8_t count = 0;
	if (count < 8)
	{
#ifdef CONFIG_ARDUINO_API
		blink_arduino();
#else
		count = 7;
#endif
	}
	else
	{
		blink_zephyr();
	}
	count++;
	if (count >= 16)
	{
		count = 0;
	}	
}
```

## src/digital.h
```c
#ifdef CONFIG_ARDUINO_API
	#include <Arduino.h>
#endif

#ifndef INCLUDE_DIGITAL_H

////////////////////////////////////////
void setup_digital	(void);
void blink			(void);

#endif      // INCLUDE_DIGITAL_H
```

## src/rtt.cpp
```c
#include <SEGGER_RTT.h>

////////////////////////////////////////////////////////////////////////////////
void setup_rtt (void)
{
	SEGGER_RTT_Init();
	SEGGER_RTT_printf(0, "Hello World\n");			// Example SEGGER_RTT_write() usage
}

////////////////////////////////////////////////////////////////////////////////
void rtt_print (const char* const msg)
{
	SEGGER_RTT_printf(0, msg);
}
```

## src/rtt.h
```c
#ifndef INCLUDE_RTT_H

////////////////////////////////////////
void setup_rtt (void);
void rtt_print (const char* const msg);

#endif      // INCLUDE_RTT_H
```

## src/serial.cpp
```c
#include <zephyr/kernel.h>
#include <zephyr/device.h>
#include <zephyr/drivers/uart.h>
#include <string.h>
#include "serial.h"


////////////////////////////////////////
static void uart_irq_callback(const struct device* dev, void* user_data);
static void zephyr_serial_out(const char* const buf);
static void zephyr_setup_serial(void);


////////////////////////////////////////////////////////////////////////////////
static void arduino_setup_serial (uint32_t baud_rate)
{
#ifdef CONFIG_ARDUINO_API
	Serial.begin(baud_rate);
#endif
}

////////////////////////////////////////////////////////////////////////////////
static void arduino_serial_out (const char* const msg)
{
#ifdef CONFIG_ARDUINO_API
	Serial.println(msg);
#endif
}

////////////////////////////////////////////////////////////////////////////////
void setup_serial (void)
{
	arduino_setup_serial(115200);

#ifdef ENABLE_ZEPHYR_SERIAL
	// zephyr_setup_serial() initialises uart1 which is shared with the modem 
	// control. If we re-initialise uart1 here, then we take over comms with the
	// modem and user cannot issue AT commands any more. Therefore this feature
	// will be disabled unless needed for testing.
	zephyr_setup_serial();
#else
	(void)zephyr_setup_serial;
#endif
}

////////////////////////////////////////////////////////////////////////////////
void serial_out (const char* const msg)
{
	arduino_serial_out(msg);
}

////////////////////////////////////////
// change this to any other UART peripheral if desired 
#define UART_DEVICE_NODE DT_ALIAS(uart0)

static const struct device* const uart_dev = DEVICE_DT_GET(UART_DEVICE_NODE);


#define MSG_SIZE 32

// queue to store up to 10 messages (aligned to 4-byte boundary)
K_MSGQ_DEFINE(uart_msgq, MSG_SIZE, 10, 4);

// receive buffer used in UART ISR callback
static char rx_buf[MSG_SIZE];
static unsigned int rx_buf_pos;

////////////////////////////////////////////////////////////////////////////////
static void zephyr_setup_serial (void)
{
	if (device_is_ready(uart_dev) == false) 
	{
		printk("UART device not found!\n");
		k_oops();
	}

	// configure interrupt and callback to receive data 
	int result = uart_irq_callback_user_data_set(uart_dev, uart_irq_callback, NULL);
	if (result < 0) 
	{
		if (result == -ENOTSUP) 
		{
			printk("Interrupt-driven UART API support not enabled\n");
		} 
		else if (result == -ENOSYS) 
		{
			printk("UART device does not support interrupt-driven API\n");
		} 
		else 
		{
			printk("Error setting UART callback: %d\n", result);
		}
		k_oops();
	}

	uart_config uart_cfg = {
		.baudrate   = 115200,
		.parity     = UART_CFG_PARITY_NONE,
		.stop_bits  = UART_CFG_STOP_BITS_1,
		.data_bits  = UART_CFG_DATA_BITS_8,
		.flow_ctrl  = UART_CFG_FLOW_CTRL_NONE,
	};
	result = uart_configure(uart_dev, &uart_cfg);
	if (result < 0) 
	{
		printk("uart_configure failed (err=%d)\n", result);
		k_oops();
	}

	uart_irq_rx_enable(uart_dev);

	zephyr_serial_out("Hello! I'm your echo bot.\r\n");
	zephyr_serial_out("Tell me something and press enter:\r\n");
}

////////////////////////////////////////////////////////////////////////////////
// Print a null-terminated string character by character to the UART interface
void zephyr_serial_out (const char* const buf)
{
	int msg_len = strlen(buf);

	for (int i = 0; i < msg_len; i++) 
	{
		uart_poll_out(uart_dev, buf[i]);
	}
}

////////////////////////////////////////////////////////////////////////////////
void serial_read (void)
{
	char tx_buf[MSG_SIZE];

	if (k_msgq_get(&uart_msgq, &tx_buf, K_MSEC(0)) == 0)
	{
		zephyr_serial_out("Echo: ");
		zephyr_serial_out(tx_buf);
		zephyr_serial_out("\r\n");
	}
}

////////////////////////////////////////////////////////////////////////////////
//
// Read characters from UART until line end is detected. Afterwards push the
// data to the message queue.
//
void uart_irq_callback(const struct device* dev, void* user_data)
{
	if (uart_irq_update  (uart_dev) == false)		return;
	if (uart_irq_rx_ready(uart_dev) == false)	    return;

	// read until FIFO empty
	uint8_t c;
	while (uart_fifo_read(uart_dev, &c, 1) == 1) 
	{
		if ((c == '\n' || c == '\r') && rx_buf_pos > 0) 
		{
			rx_buf[rx_buf_pos] = '\0';			// terminate string

			// if queue is full, message is silently dropped
			k_msgq_put(&uart_msgq, &rx_buf, K_NO_WAIT);

			// reset the buffer (it was copied to the msgq)
			rx_buf_pos = 0;
		}
		else if (rx_buf_pos < (sizeof(rx_buf) - 1)) 
		{
			rx_buf[rx_buf_pos++] = c;
		}
		// else: characters beyond buffer size are dropped
	}
}
```

## src/serial.h
```c
#ifdef CONFIG_ARDUINO_API
	#include <Arduino.h>
#endif

#ifndef INCLUDE_SERIAL_H

////////////////////////////////////////
void setup_serial	(void);
void serial_out		(const char* const msg);
void serial_read	(void);

#endif      // INCLUDE_SERIAL_H
```
